## boards/shields/charybdis_dongled/Kconfig.shield
```kconfig
config SHIELD_CHARYBDIS_DONGLED_LEFT
    def_bool $(shields_list_contains,charybdis_dongled_left)

config SHIELD_CHARYBDIS_DONGLED_RIGHT
    def_bool $(shields_list_contains,charybdis_dongled_right)

config SHIELD_CHARYBDIS_DONGLED_DONGLE
    def_bool $(shields_list_contains,charybdis_dongled_dongle)
```

## boards/shields/charybdis_mini/Kconfig.defconfig
```kconfig
if SHIELD_CHARYBDIS_MINI_LEFT

config ZMK_KEYBOARD_NAME
    default "Charybdis"

config ZMK_SPLIT_ROLE_CENTRAL
    default y

endif # SHIELD_CHARYBDIS_MINI_LEFT

if SHIELD_CHARYBDIS_MINI_LEFT || SHIELD_CHARYBDIS_MINI_RIGHT

config ZMK_SPLIT
    default y

endif # SHIELD_CHARYBDIS_MINI_LEFT || SHIELD_CHARYBDIS_MINI_RIGHT
```

## config/west.yml
```yaml
manifest:
  defaults:
    revision: v0.3
  remotes:
    - name: zmkfirmware
      url-base: https://github.com/zmkfirmware
    - name: lightbulbjim
      url-base: https://github.com/lightbulbjim
    - name: carrefinho
      url-base: https://github.com/carrefinho
  projects:
    - name: zmk
      remote: zmkfirmware
      import: app/west.yml
    - name: zmk-pmw3610-driver
      remote: lightbulbjim
      revision: main
    - name: prospector-zmk-module
      remote: carrefinho
      revision: main
  self:
    path: config
```
